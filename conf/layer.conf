## conf/layer.conf
```bitbake
# This software is a part of ISAR.
# Copyright (C) 2015-2017 ilbers GmbH

# We have a conf and classes directory, add to BBPATH
BBPATH .= ":${LAYERDIR}"

# We have recipes-* directories, add to BBFILES
BBFILES +=  "${LAYERDIR}/recipes-*/*/*.bb"

BBFILE_COLLECTIONS += "hello"
BBFILE_PATTERN_hello = "^${LAYERDIR}/"
BBFILE_PRIORITY_hello = "11"

# This should only be incremented on significant changes that will
# cause compatibility issues with other layers
LAYERVERSION_hello = "3"
LAYERSERIES_COMPAT_hello = "v0.6"

LAYERDIR_hello = "${LAYERDIR}"
LAYERDIR_hello[vardepvalue] = "meta-hello"
```
